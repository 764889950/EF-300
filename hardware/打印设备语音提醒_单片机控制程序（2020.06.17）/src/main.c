/******************************************************************************************************************
        
							+--------------------------------------------------+
							             	 主函数部分
							+--------------------------------------------------+

 - 实现功能：

 - 目前进展：
 - 日期    ：2020-06-08

 - 作者    ：

 - 运行环境：STC   晶振：22.1184M     波特率:9600

 - 备注    ：在ASR M08语音模块上上调试OK --- STC11L16XE+
 
 1、实现芯片上电分别指定播放第一曲和第二曲，基本的程序供用户测试
 2、该测试程序必须是模块或者芯片方案中，有设备在线，譬如U盘、TF卡、FLASH等等
 3、
******************************************************************************************************************/
#include "STK6037.h"

static INT8U Send_buf[10] = {0} ;
static INT8U Recv_buf[10] = {0} ;


/*****************************************************************************************************
 - 功能描述：10us的延时函数
 - 隶属模块：常用函数库(内部)
 - 参数说明：无
 - 返回参数：无
 - 注： 在这里的运行环境是51,晶振为12MHZ		
*****************************************************************************************************/
void Delay_Us(INT32U z)
{
	while(z--);
}

/***********************毫秒级别延时************************/

void Delay_Ms(INT32U z)
{
	INT32U x=0 , y=0;
	for(x=110 ; x>0 ;x--)
	for(y=z; y>0;y-- );
}

/*****************************************************************************************************
 - 功能描述： 串口1初始化
 - 隶属模块： 外部
 - 参数说明： 无
 - 返回说明： 无
 - 注：	      22.1184MHz晶振下，都是9600波特率
*****************************************************************************************************/
void UartConfiguration()
{
	TMOD=0x20;     
	TH1=0xfa;			
	TL1=0xfa;		
	PCON=0x00;     
	SCON=0x50;		
	EA=1;	
	ES=1;	
	TR1=1;
}
/********************************************************************************************
 - 功能描述： 串口发送一个字节
 - 隶属模块： 外部
 - 参数说明：
 - 返回说明：
 - 注：	      
********************************************************************************************/
void Uart_PutByte(INT8U ch)
{
    SBUF  = ch;
    while(!TI);
    TI = 0;
}

/*****************************************************************************************************
 - 功能描述： 串口发送一帧数据
 - 隶属模块： 内部 
 - 参数说明： 
 - 返回说明： 
 - 注：无     
*****************************************************************************************************/
void SendCmd(INT8U len)
{
	INT8U i = 0 ;
	Uart_PutByte(0x7E); //起始
	for(i=0; i<len; i++)//数据
	{
		Uart_PutByte(Send_buf[i]) ;
	}
	Uart_PutByte(0xEF) ;//结束
}

/********************************************************************************************
 - 功能描述：求和校验
 - 隶属模块：
 - 参数说明：
 - 返回说明：
 - 注：      和校验的思路如下
             发送的指令，去掉起始和结束。将中间的6个字节进行累加，最后取反码
             接收端就将接收到的一帧数据，去掉起始和结束。将中间的数据累加，再加上接收到的校验
             字节。刚好为0.这样就代表接收到的数据完全正确。
********************************************************************************************/
void DoSum( INT8U *Str, INT8U len)
{
    INT16U xorsum = 0;
    INT8U i;

    for(i=0; i<len; i++)
    {
        xorsum  = xorsum + Str[i];
    }
	xorsum     = 0 -xorsum;
	*(Str+i)   = (INT8U)(xorsum >>8);
	*(Str+i+1) = (INT8U)(xorsum & 0x00ff);
}


/********************************************************************************************
 - 功能描述： 串口向外发送命令[包括控制和查询]
 - 隶属模块： 外部
 - 参数说明： CMD:表示控制指令，请查阅指令表，还包括查询的相关指令
              feedback:是否需要应答[0:不需要应答，1:需要应答]
              data:传送的参数
 - 返回说明：
 - 注：       
********************************************************************************************/
void Uart_SendCMD(INT8U CMD ,INT8U feedback , INT16U dat)
{
    Send_buf[0] = 0xff;    //保留字节 
    Send_buf[1] = 0x06;    //长度
    Send_buf[2] = CMD;     //控制指令
    Send_buf[3] = feedback;//是否需要反馈
    Send_buf[4] = (INT8U)(dat >> 8);//datah
    Send_buf[5] = (INT8U)(dat);     //datal
    DoSum(&Send_buf[0],6);        //校验
    SendCmd(8);       //发送此帧数据
}

static INT8U date;

void main()
{ 
	P1=0x00;
	Delay_Ms(3000) ;

	UartConfiguration();
	
	while(1)
	{
		if(P1==0x01)//P1.0为高电平时，进入控制
		{
			resend_1:
			Uart_SendCMD(0x12 , 0 , 0x01) ;//播放TF卡中 "中"0001"曲目,0001打印已完成
			Delay_Ms(30000) ;
			Delay_Ms(30000) ;

			if(date!=0xEF)
			{
				goto resend_1;
			}
			date=0;
		}
		
		if(P1==0x10)//P1.1为高电平时，进入控制
		{		
			resend_2:
			Uart_SendCMD(0x12 , 0 , 0x02) ;//播放TF卡中 "MP3"中"0002"曲目，,0002打印仓门未关
			Delay_Ms(30000) ;
			Delay_Ms(30000) ;

			if(date!=0xEF)
			{
				goto resend_2;
			}
			date=0;
		}
	}
}

void Uart() interrupt 4
{
	if(RI==1)
	{
		date=SBUF; 
		RI=0;	
	}
}

//7E FF 06 3D 00 00 08 FE B6 EF 7E FF 06 3D 00 00 08 FE B6 EF 
//7E FF 06 3D 00 00 07 FE B7 EF 7E FF 06 3D 00 00 07 FE B7 EF 